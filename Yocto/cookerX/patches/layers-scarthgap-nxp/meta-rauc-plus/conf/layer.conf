## Yocto/cookerX/patches/layers-scarthgap-nxp/meta-rauc-plus/conf/layer.conf
```bitbake
# We have a conf and classes directory, add to BBPATH
BBPATH .= ":${LAYERDIR}"

# We have recipes-* directories, add to BBFILES
BBFILES += "${LAYERDIR}/recipes-*/*/*.bb \
            ${LAYERDIR}/recipes-*/*/*.bbappend"

BBFILE_COLLECTIONS += "meta-rauc-plus"
BBFILE_PATTERN_meta-rauc-plus = "^${LAYERDIR}/"
BBFILE_PRIORITY_meta-rauc-plus = "6"

LAYERDEPENDS_meta-rauc-plus = "core"
LAYERSERIES_COMPAT_meta-rauc-plus = "langdale scarthgap"
```

## Yocto/cookerX/patches/layers-walnascar-nxp/meta-homeassistant-plus-2025.4.0/conf/layer.conf
```bitbake
# We have a conf and classes directory, add to BBPATH
BBPATH .= ":${LAYERDIR}"

# We have recipes-* directories, add to BBFILES
BBFILES += "${LAYERDIR}/recipes-*/*/*.bb \
            ${LAYERDIR}/recipes-*/*/*.bbappend"

BBFILE_COLLECTIONS += "meta-homeassistant-plus"
BBFILE_PATTERN_meta-homeassistant-plus = "^${LAYERDIR}/"
BBFILE_PRIORITY_meta-homeassistant-plus = "6"

LAYERDEPENDS_meta-homeassistant-plus = "core"
LAYERSERIES_COMPAT_meta-homeassistant-plus = "scarthgap walnascar"
```
